## config/west.yml
```yaml
# refresh 1
manifest:
  defaults:
    revision: v0.3
  remotes:
    - name: zmkfirmware
      url-base: https://github.com/zmkfirmware
    - name: alfalfasprout69
      url-base: https://github.com/alfalfasprout69
  projects:
    - name: zmk
      remote: zmkfirmware
      import: app/west.yml
    - name: zmk-rgbled-widget
      remote: alfalfasprout69
      revision: arrow-v0.3
  self:
    path: config
```
